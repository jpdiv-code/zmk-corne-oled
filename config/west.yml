## config/west.yml
```yaml
manifest:
  remotes:
    - name: zmkfirmware
      url-base: https://github.com/zmkfirmware
    - name: mctechnology17
      url-base: https://github.com/mctechnology17
    - name: jpdiv-code
      url-base: https://github.com/jpdiv-code
    - name: eyelash
      url-base: https://github.com/a741725193
  projects:
    - name: zmk
      remote: zmkfirmware
      revision: v0.3.0
      import: app/west.yml
    - name: zmk-nice-oled
      remote: jpdiv-code
      revision: 6fe174c444a8282d3b7b4bf9322293929c4d1cc9
    - name: zmk-board-eyelash
      remote: eyelash
      revision: main
  self:
    path: config
```
